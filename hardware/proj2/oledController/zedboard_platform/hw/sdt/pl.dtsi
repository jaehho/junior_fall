/ {
	amba_pl: amba_pl {
		ranges;
		compatible = "simple-bus";
		#address-cells = <1>;
		#size-cells = <1>;
		oledControl_IP_0: oledControl_IP@43c00000 {
			xlnx,s00-axi-data-width = <32>;
			xlnx,rable = <0>;
			compatible = "xlnx,oledControl-IP-1.0";
			status = "okay";
			clock-names = "s00_axi_aclk";
			xlnx,s00-axi-addr-width = <4>;
			xlnx,ip-name = "oledControl_IP";
			xlnx,edk-iptype = "PERIPHERAL";
			reg = <0x43c00000 0x10000>;
			clocks = <&clkc 15>;
			xlnx,name = "oledControl_IP_0";
		};
	};
};
